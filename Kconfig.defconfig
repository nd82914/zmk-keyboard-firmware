## Kconfig.shield
```kconfig
# Kconfig.shield

menu "MOTTABLEKEY Shield Configuration"

config MOTTABLEKEY_FEATURE
    bool "Enable MOTTABLEKEY Features"
    default y
    help
      Enable additional features specific to the MOTTABLEKEY shield.

config MOTTABLEKEY_BACKLIGHT
    bool "Enable Backlight"
    default n
    help
      Enable backlighting for the MOTTABLEKEY keyboard.

config MOTTABLEKEY_RGB
    bool "Enable RGB Lighting"
    default n
    help
      Enable RGB lighting effects on the MOTTABLEKEY keyboard.

endmenu
```

## config/boards/shields/mottablekey/Kconfig.defconfig
```kconfig
if SHIELD_MOTTABLEKEY_R

config ZMK_KEYBOARD_NAME
    default "mottablekey_R"

config ZMK_SPLIT
    default y

config ZMK_SPLIT_ROLE_CENTRAL
    default y

endif

if SHIELD_MOTTABLEKEY_L

config ZMK_KEYBOARD_NAME
    default "mottablekey_L"

config ZMK_SPLIT
    default y

endif
```

## config/boards/shields/mottablekey/Kconfig.shield
```kconfig
config SHIELD_MOTTABLEKEY_R
    def_bool $(shields_list_contains,mottablekey_R)

config SHIELD_MOTTABLEKEY_L
    def_bool $(shields_list_contains,mottablekey_L)
```

## config/west.yml
```yaml
manifest:
  remotes:
    - name: zmkfirmware
      url-base: https://github.com/zmkfirmware
    - name: inorichi
      url-base: https://github.com/inorichi
  projects:
    - name: zmk
      remote: zmkfirmware
      revision: main
      import: app/west.yml
    - name: zmk-pmw3610-driver
      remote: inorichi
      revision: main
      path: modules/drivers/pmw3610
  self:
    path: config
```

## west.yml
```yaml
version: 0.12.0
manifest:
  projects:
    - name: zmk
      url: https://github.com/zephyrproject-rtos/zmk.git
      revision: main
      path: zmk
    - name: zmk-config
      url: https://github.com/yourusername/zmk-config.git
      revision: main
      path: zmk-config
  self:
    path: .
```
